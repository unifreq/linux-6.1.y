// SPDX-License-Identifier: (GPL-2.0+ OR MIT)
/*
 * Copyright (c) 2017 PINE64
 */

/dts-v1/;
#include "rk3328-beikeyun-1296mhz.dts"

&vdd_arm {
	regulator-min-microvolt = <950000>;
};

&cpu0_opp_table {

	opp-1392000000 {
		status = "okay";
	};

	opp-1512000000 {
		opp-microvolt = <1450000>;
		status = "okay";
	};
};
