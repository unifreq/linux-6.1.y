/dts-v1/;
/plugin/;

/ {
	fragment@0 {
		target = <&vcc5v0_sata>;
		__overlay__ {
			status = "disabled";
		};
	};

	fragment@1 {
		target = <&sata0>;
		__overlay__ {
			status = "disabled";
		};
	};
};
