/dts-v1/;
/plugin/;

/ {
	fragment@0 {
		target = <&vcc3v3_pcie2>;
		__overlay__ {
			status = "disabled";
		};
	};

	fragment@1 {
		target = <&pcie2x1>;
		__overlay__ {
			status = "disabled";
		};
	};
};
