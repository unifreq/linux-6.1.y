// SPDX-License-Identifier: (GPL-2.0+ OR MIT)
/*
 * Author: flippy <flippy@sina.com>
 */

/dts-v1/;

#include "meson-sm1-hk1box-vontar-x3.dts"

/ {
	model = "HK1 Box/Vontar X3 @ 2208Mhz";
};

&cpu_opp_table {
	opp-2100000000 {
		opp-hz = /bits/ 64 <2100000000>;
		opp-microvolt = <1011000>;
	};

	opp-2208000000 {
		opp-hz = /bits/ 64 <2208000000>;
		opp-microvolt = <1021000>;
	};
};
