// SPDX-License-Identifier: (GPL-2.0+ OR MIT)

/*
 * Author: Christian Hewitt <christianshewitt@gmail.com>
 */

#include "meson-gxl-s905d-p230.dts"

/ {
	compatible = "videostrong,gxl-ki-pro", "amlogic,s905d", "amlogic,meson-gxl";
	model = "MeCool KI Pro";
};

&ir {
	linux,rc-map-name = "rc-mecool-ki-pro";
};
