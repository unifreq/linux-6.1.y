// SPDX-License-Identifier: (GPL-2.0+ OR MIT)
/*
 * Copyright (c) 2016 Endless Computers, Inc.
 * Author: Carlo Caione <carlo@endlessm.com>
 * Create by flippy
 */

/dts-v1/;

#include "meson-gxm-q201.dts"

/ {
	compatible = "phicomm,t1", "amlogic,meson-gxm";
	model = "Phicomm T1";

	aliases {
		serial1 = &uart_A;
	};
};

&uart_A {
	status = "okay";
	pinctrl-0 = <&uart_a_pins>, <&uart_a_cts_rts_pins>;
	pinctrl-names = "default";
	uart-has-rtscts;

	bluetooth {
		compatible = "brcm,bcm43438-bt";
		shutdown-gpios = <&gpio GPIOX_17 GPIO_ACTIVE_HIGH>;
		max-speed = <2000000>;
	};
};
