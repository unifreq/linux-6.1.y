## Documentation/devicetree/bindings/auxdisplay/titanmec,tm1628.yaml
```yaml
# SPDX-License-Identifier: (GPL-2.0-or-later OR BSD-2-Clause)
%YAML 1.2
---
$id: http://devicetree.org/schemas/leds/titanmec,tm1628.yaml#
$schema: http://devicetree.org/meta-schemas/core.yaml#

title: Titan Micro Electronics TM1628 LED controller

properties:
  compatible:
    enum:
    - titanmec,tm1628

  reg:
    maxItems: 1

  grid:
    description:
      Mapping of display digit position to grid number.
      This implicitly defines the display size.
    $ref: /schemas/types.yaml#/definitions/uint8-array
    minItems: 1
    maxItems: 7

  segment-mapping:
    description:
      Mapping of 7 segment display segments A-G to bit numbers 1-12.
    $ref: /schemas/types.yaml#/definitions/uint8-array
    minItems: 7
    maxItems: 7

  "#address-cells":
    const: 2

  "#size-cells":
    const: 0

required:
  - compatible
  - reg

patternProperties:
  "^.*@[1-7],([1-9]|1[0-6])$":
    type: object
    description: |
      Properties for a single LED.

    properties:
      reg:
        description: |
          1-based grid number, followed by 1-based segment bit number.
        maxItems: 1

    required:
      - reg

examples:
  - |
    #include <dt-bindings/leds/common.h>

    spi {
        #address-cells = <1>;
        #size-cells = <0>;

        led-controller@0 {
            compatible = "titanmec,tm1628";
            reg = <0>;
            spi-3-wire;
            spi-lsb-first;
            spi-max-frequency = <500000>;
            grid = /bits/ 8 <4 3 2 1>;
            segment-mapping = /bits/ 8 <4 5 6 1 2 3 7>;
            #address-cells = <2>;
            #size-cells = <0>;

            alarmn@5,4 {
                reg = <5 4>;
                function = LED_FUNCTION_ALARM;
            };
        };
    };
...
```

## drivers/crypto/cryptodev-linux/Kconfig
```kconfig
# SPDX-License-Identifier: GPL-2.0-only
config CRYPTO_DEV_CRYPTODEV_LINUX
	tristate "Cryptodev-Linux driver"
	default m
	help
	  Cryptodev-linux is a device that allows access to Linux kernel cryptographic drivers; thus allowing of userspace applications to take advantage of hardware accelerators. Cryptodev-linux is implemented as a standalone module that requires no dependencies other than a stock linux kernel. Its API is compatible with OpenBSD's cryptodev userspace API (/dev/crypto).
```

## drivers/crypto/rockchip/Kconfig
```kconfig
config CRYPTO_DEV_ROCKCHIP
	tristate "Rockchip's Cryptographic Engine driver"
	depends on OF && ARCH_ROCKCHIP
	depends on PM
	select CRYPTO_ECB
	select CRYPTO_CBC
	select CRYPTO_DES
	select CRYPTO_AES
	select CRYPTO_ENGINE
	select CRYPTO_LIB_DES
	select CRYPTO_MD5
	select CRYPTO_SHA1
	select CRYPTO_SHA256
	select CRYPTO_HASH
	select CRYPTO_SKCIPHER

	help
	  This driver interfaces with the hardware crypto accelerator.
	  Supporting cbc/ecb chainmode, and aes/des/des3_ede cipher mode.

config CRYPTO_DEV_ROCKCHIP_DEBUG
	bool "Enable Rockchip crypto stats"
	depends on CRYPTO_DEV_ROCKCHIP
	depends on DEBUG_FS
	help
	  Say y to enable Rockchip crypto debug stats.
	  This will create /sys/kernel/debug/rk3288_crypto/stats for displaying
	  the number of requests per algorithm and other internal stats.

config CRYPTO_DEV_ROCKCHIP2
	tristate "Rockchip's cryptographic offloader V2"
	depends on OF && ARCH_ROCKCHIP
	depends on PM
	select CRYPTO_ECB
	select CRYPTO_CBC
	select CRYPTO_AES
	select CRYPTO_MD5
	select CRYPTO_SHA1
	select CRYPTO_SHA256
	select CRYPTO_SM3
	select CRYPTO_HASH
	select CRYPTO_SKCIPHER
	select CRYPTO_ENGINE

	help
	  This driver interfaces with the hardware crypto offloader present
	  on RK3568 and RK3588.

config CRYPTO_DEV_ROCKCHIP2_DEBUG
	bool "Enable Rockchip V2 crypto stats"
	depends on CRYPTO_DEV_ROCKCHIP2
	depends on DEBUG_FS
	help
	  Say y to enable Rockchip crypto debug stats.
	  This will create /sys/kernel/debug/rk3588_crypto/stats for displaying
	  the number of requests per algorithm and other internal stats.
```

## drivers/net/ethernet/realtek/r8125_vendor/Kconfig
```kconfig
config R8125
	tristate "Realtek 8125A/8125B/8125BP/8125D/8168KB ethernet support by vendor"
	depends on PCI
	select FW_LOADER
	select CRC32
	select PHYLIB
	select REALTEK_PHY
	select OF
	help
	  Say Y here if you have a Realtek Ethernet adapter belonging to
	  the following families:
	  RTL8125A/B/BP/D 2.5Gbps Ethernet
	  RTL8168KB 2.5Gbps Ethernet

	  To compile this driver as a module, choose M here: the module
	  will be called r8125.  This is recommended.

config R8125_SOC_LAN
	bool "Enable HW optimize function"
	default y
	depends on R8125
	help
	  This enables HW optimize function.
	  If unsure, say Y.

config R8125_REALWOW_SUPPORT
	bool "Enable Realtek RealWOW Technology"
	default n
	depends on R8125
	help
	  This enables ENABLE_REALWOW_SUPPORT flag.
	  Support Realtek RealWOW Technology.
	  If unsure, say N.

config R8125_DASH_SUPPORT
	bool "Enable Realtek Dash Management Console"
	default n
	depends on R8125
	help
	  This enables ENABLE_DASH_SUPPORT flag.
	  Support Realtek Dash Management Console.
	  If unsure, say N.

config R8125_DASH_PRINT_SUPPORT
	bool "Enable Realtek Dash Print"
	default n
	depends on R8125
	depends on R8125_DASH_SUPPORT
	help
	  This enables ENABLE_DASH_PRINTER_SUPPORT flag.
	  Support Realtek Dash Print.
	  If unsure, say N.

config R8125_DOWN_SPEED_100
	bool "Down speed 100"
	default n
	depends on R8125
	help
	  This enables CONFIG_DOWN_SPEED_100 flag.
	  If unsure, say N.

config R8125_ASPM
	bool "Support PCIE ASPM"
	default y
	depends on R8125
	help
	  This enables CONFIG_ASPM flag.
	  Support Active-state power management (ASPM).
	  If unsure, say Y.

config R8125_WOL_SUPPORT
	bool "Enable WOL Support"
	default y
	depends on R8125
	help
	  If enabled, the DISABLE_WOL_SUPPORT is not set.
	  Enable WOL Support.
	  If unsure, say Y.

config R8125_S5WOL
	bool "Support Wake On LAN for S5"
	default y
	depends on R8125
	depends on R8125_WOL_SUPPORT
	help
	  This enables ENABLE_S5WOL flag.
	  Support Wake On LAN for S5.
	  If unsure, say Y.

config R8125_S5_KEEP_CURR_MAC
	bool "keep mac on after shutdown"
	default n
	depends on R8125
	depends on R8125_WOL_SUPPORT
	help
	  This enables ENABLE_S5_KEEP_CURR_MAC flag.
	  If enabled, will keep the mac on after shutdown.
	  If unsure, say N.

config R8125_EEE
	bool "Support Energy-Efficient Ethernet (EEE)"
	default y
	depends on R8125
	help
	  This enables ENABLE_EEE flag.
	  Support Energy-Efficient Ethernet (EEE).
	  If unsure, say Y.

config R8125_S0_MAGIC_PACKET
	bool "Enable Magic Packet"
	default n
	depends on R8125
	help
	  This enables ENABLE_S0_MAGIC_PACKET flag.
	  Enable magic packet.
	  If unsure, say N.

config R8125_TX_NO_CLOSE
	bool "Enable TX_NO_CLOSE"
	default y
	depends on R8125
	help
	  This enables ENABLE_TX_NO_CLOSE flag.
	  If unsure, say Y.

config R8125_MULTI_MSIX_VECTOR
	bool "Enable Multi MSIX Vector"
	default n
	depends on R8125
	help
	  If enabled, the DISABLE_MULTI_MSIX_VECTOR flag is not set.

config R8125_MULTIPLE_TX_QUEUE
	bool "Enable Multiple tx queue"
	default y
	depends on R8125
	depends on R8125_MULTI_MSIX_VECTOR
	help
	  This enables ENABLE_MULTIPLE_TX_QUEUE flag.
	  Support Multiple tx queue.
	  If unsure, say Y.

config R8125_RSS_SUPPORT
	bool "Enable Receive Side Scaling (RSS)"
	default y
	depends on R8125
	depends on R8125_MULTI_MSIX_VECTOR
	help
	  This enables ENABLE_RSS_SUPPORT flag.
	  Support Receive Side Scaling (RSS).
	  If unsure, say Y.

config R8125_PTP_SUPPORT
	bool "Support PTP clock"
	default n
	depends on PTP_1588_CLOCK
	depends on R8125
	help
	  This enables ENABLE_PTP_SUPPORT flag.
	  Support IEEE 1588 PTP Clock.

config R8125_PTP_MASTER_MODE
	bool "Enable PTP Master mode"
	default n
	depends on R8125
	depends on R8125_PTP_SUPPORT
	help
	  This enables ENABLE_PTP_MASTER_MODE flag.
	  Enable PTP master mode.

config R8125_FIBER_SUPPORT
	bool "Enable fiber support"
	default y
	depends on R8125
	help
	  This enables DENABLE_FIBER_SUPPORT flag.

config R8125_USE_FIRMWARE_FILE
	bool "Use firmware file"
	default n
	depends on R8125
	help
	  This enables ENABLE_USE_FIRMWARE_FILE flag.
	  Use external firmware file, the path is "/lib/firmware/rtl_nic/".
	  If unsure, say N.

config R8125_DOUBLE_VLAN
	bool "Enable double vlan"
	default n
	depends on R8125
	help
	  This enables ENABLE_DOUBLE_VLAN flag.
	  If unsure, say N.

config R8125_PAGE_REUSE
	bool "Enable page reuse"
	default n
	depends on R8125
	help
	  This enables ENABLE_PAGE_REUSE flag.
	  If unsure, say N.

config R8125_GIGA_LITE
	bool "Supports Giga Lite (500M) mode"
	default y
	depends on R8125
	help
	  This enables ENABLE_GIGA_LITE flag.
	  Support Giga Lite (500M) mode.
```

## drivers/net/ethernet/realtek/r8168_vendor/Kconfig
```kconfig
config R8168
	tristate "Realtek 8111/8411/8168 ethernet support by vendor"
	depends on PCI
	select FW_LOADER
	select CRC32
	select PHYLIB
	select REALTEK_PHY
	select OF
	help
	  Say Y here if you have a Realtek Ethernet adapter belonging to
	  the following families:
	  RTL8111/C/D/D/E/F/G/H GBit Ethernet
	  RTL8168B/C/D/E/F/G/H GBit Ethernet
	  RTL8411/B GBit Ethernet

	  To compile this driver as a module, choose M here: the module
	  will be called r8168.  This is recommended.

config R8168_SOC_LAN
	bool "Enable HW optimize function"
	default y
	depends on R8168
	help
	  This enables HW optimize function.
	  If unsure, say Y.

config R8168_FIBER_SUPPORT
	bool "Enable fiber support"
	default n
	depends on R8168
	help
	  This enables ENABLE_FIBER_SUPPORT flag,
	  If unsure, say N.

config R8168_REALWOW_SUPPORT
	bool "Enable Realtek RealWOW Technology"
	default n
	depends on R8168
	help
	  This enables ENABLE_REALWOW_SUPPORT flag.
	  Support Realtek RealWOW Technology.
	  If unsure, say N.

config R8168_DASH_SUPPORT
	bool "Enable Realtek Dash Management Console"
	default n
	depends on R8168
	help
	  This enables ENABLE_DASH_SUPPORT flag.
	  Support Realtek Dash Management Console.
	  If unsure, say N.

config R8168_DASH_PRINT_SUPPORT
	bool "Enable Realtek Dash Print"
	default n
	depends on R8168
	depends on R8168_DASH_SUPPORT
	help
	  This enables ENABLE_DASH_PRINTER_SUPPORT flag.
	  Support Realtek Dash Print.
	  If unsure, say N.

config R8168_DOWN_SPEED_100
	bool "Down speed 100"
	default n
	depends on R8168
	help
	  This enables CONFIG_DOWN_SPEED_100 flag.
	  If unsure, say N.

config R8168_ASPM
	bool "Support PCIE ASPM"
	default y
	depends on R8168
	help
	  This enables CONFIG_ASPM flag.
	  Support Active-state power management (ASPM).
	  If unsure, say Y.

config R8168_DYNAMIC_ASPM
	bool "Enable dynamic PCIE ASPM"
	default y
	depends on R8168
	depends on R8168_ASPM
	help
	  This enables CONFIG_DYNAMIC_ASPM flag.
	  If unsure, say Y.

config R8168_WOL_SUPPORT
	bool "Enable Wake-On-Lan Support"
	default y
	depends on R8168
	help
	  This clean DISABLE_WOL_SUPPORT flag.
	  Enable WOL Support.
	  If unsure, say Y.

config R8168_S5WOL
	bool "Support Wake-On-LAN for S5"
	default y
	depends on R8168
	depends on R8168_WOL_SUPPORT
	help
	  This enables ENABLE_S5WOL flag.
	  Support Wake On LAN for S5.

config R8168_S5_KEEP_CURR_MAC
	bool "keep mac on after shutdown"
	default n
	depends on R8168
	depends on R8168_WOL_SUPPORT
	help
	  This enables ENABLE_S5_KEEP_CURR_MAC flag.
	  If enabled, will keep the mac on after shutdown.
	  If unsure, say N.

config R8168_EEE
	bool "Support Energy-Efficient Ethernet (EEE)"
	default y
	depends on R8168
	help
	  This enables ENABLE_EEE flag.
	  Support Energy-Efficient Ethernet (EEE).
	  If unsure, say Y.

config R8168_S0_MAGIC_PACKET
	bool "Enable Magic Packet"
	default n
	depends on R8168
	help
	  This enables ENABLE_S0_MAGIC_PACKET flag.
	  Enable magic packet.
	  If unsure, say N.

config R8168_USE_FIRMWARE_FILE
	bool "Use firmware file"
	default n
	depends on R8168
	help
	  This enables ENABLE_USE_FIRMWARE_FILE flag.
	  Use firmware file.
	  If unsure, say N.

config R8168_CTAP_SHORT_OFF
	bool "CTAP Short off"
	default n
	depends on R8168
	help
	  This enables CONFIG_CTAP_SHORT_OFF flag.
	  If unsure, say N.

config R8168_MULTIPLE_TX_QUEUE
	bool "Enable Multiple tx queue"
	default n
	depends on R8168
	help
	  This enables ENABLE_MULTIPLE_TX_QUEUE  flag.
	  Suport Multiple tx queue.

config R8168_RSS_SUPPORT
	bool "Enable Receive Side Scaling (RSS)"
	default n
	depends on R8168
	help
	  This enables ENABLE_RSS_SUPPORT flag.
	  Support Receive Side Scaling (RSS).

config R8168_GIGA_LITE
	bool "Supports Giga Lite (500M) mode"
	default y
	depends on R8168
	help
	  This enables ENABLE_GIGA_LITE flag.
	  Support Giga Lite (500M) mode.
```
